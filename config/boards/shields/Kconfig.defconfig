## config/boards/shields/Kconfig.defconfig
```kconfig
if SHIELD_CALDERA_LEFT

config ZMK_KEYBOARD_NAME
    default "samboard"

config ZMK_SPLIT_ROLE_CENTRAL
    default y

endif

if SHIELD_SAMBOARD_LEFT || SHIELD_SAMBOARD_RIGHT

config ZMK_SPLIT
    default y

endif
```

## config/boards/shields/samboard/Kconfig.shield
```kconfig
config SHIELD_SAMBOARD_LEFT
    def_bool $(shields_list_contains,samboard_left)

config SHIELD_SAMBOARD_RIGHT
    def_bool $(shields_list_contains,samboard_right)
```

## config/west.yml
```yaml
manifest:
  remotes:
    - name: zmkfirmware
      url-base: https://github.com/zmkfirmware
    # Additional modules containing boards/shields/custom code can be listed here as well
    # See https://docs.zephyrproject.org/3.2.0/develop/west/manifest.html#projects
  projects:
    - name: zmk
      remote: zmkfirmware
      # Pinned to pre-Zephyr-4.1 (board variant requirement broke
      # bare `nice_nano` board name). Bump after migrating build.yaml
      # to `nice_nano@1//zmk` naming.
      revision: b68b29d
      import: app/west.yml
  self:
    path: config
```
